## FIRMWARE/Kconfig.defconfig
```kconfig
if SHIELD_MY_LOVELY_KEYBOARD

config ZMK_KEYBOARD_NAME
    default "My Lovely KB"

config SPI
    default y

endif
```

## FIRMWARE/Kconfig.shield
```kconfig
config SHIELD_MY_LOVELY_KEYBOARD
    def_bool $(shields_list_contains,my_lovely_keyboard)
```
